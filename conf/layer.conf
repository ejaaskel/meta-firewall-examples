## conf/layer.conf
```bitbake
# We have a conf and classes directory, add to BBPATH
BBPATH .= ":${LAYERDIR}"

# We have recipes-* directories, add to BBFILES
BBFILES += "${LAYERDIR}/recipes-*/*/*.bb \
            ${LAYERDIR}/recipes-*/*/*.bbappend"

BBFILE_COLLECTIONS += "meta-firewall-examples"
BBFILE_PATTERN_meta-firewall-examples = "^${LAYERDIR}/"
BBFILE_PRIORITY_meta-firewall-examples = "6"

LAYERDEPENDS_meta-firewall-examples = "core"
LAYERSERIES_COMPAT_meta-firewall-examples = "kirkstone"
```
